## build/conf/bblayers.conf
```bitbake
# LAYER_CONF_VERSION is increased each time build/conf/bblayers.conf
# changes incompatibly
LCONF_VERSION = "7"

BBPATH = "${TOPDIR}"
BBFILES ?= ""

BBLAYERS ?= " \
  /entner/projects/rk_dev/distro/layers/openembedded-core/meta \
  /entner/projects/rk_dev/distro/layers/meta-openembedded/meta-oe \
  /entner/projects/rk_dev/distro/layers/meta-arm/meta-arm-toolchain \
  /entner/projects/rk_dev/distro/layers/meta-arm/meta-arm \
  /entner/projects/rk_dev/distro/layers/meta-rockchip-jeffy \
  /entner/projects/rk_dev/distro/layers/meta-muxnix \
"
```
