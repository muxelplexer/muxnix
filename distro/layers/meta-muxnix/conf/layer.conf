## distro/layers/meta-muxnix/conf/layer.conf
```bitbake
# We have a conf and classes directory, add to BBPATH
BBPATH .= ":${LAYERDIR}"

# We have recipes-* directories, add to BBFILES
BBFILES += "${LAYERDIR}/recipes-*/*/*.bb \
            ${LAYERDIR}/recipes-*/*/*.bbappend"

BBFILE_COLLECTIONS += "meta-muxnix"
BBFILE_PATTERN_meta-muxnix = "^${LAYERDIR}/"
BBFILE_PRIORITY_meta-muxnix = "9"

LAYERDEPENDS_meta-muxnix = "core meta-arm rockchip"
LAYERSERIES_COMPAT_meta-muxnix = "walnascar whinlatter"
```

## distro/layers/meta-muxnix/conf/machine/include/rk3576.inc
```bitbake
SOC_FAMILY ?= "rk3576"
MACHINEOVERRIDES =. "rk3576:"
SOC_FAMILY = "rk3576"
DEFAULTTUNE ?= "cortexa72-cortexa53"
ROCKCHIP_CLOSED_TPL ?= "1"

require conf/machine/include/soc-family.inc
require conf/machine/include/rockchip-defaults.inc
require conf/machine/include/arm/armv8a/tune-cortexa72-cortexa53.inc
require conf/machine/include/rockchip-wic.inc

PREFERRED_PROVIDER_trusted-firmware-a = "rockchip-rkbin-tf-a"
PREFERRED_PROVIDER_optee-os = "rockchip-rkbin-optee-os"

KBUILD_DEFCONFIG  ?= "defconfig"
KERNEL_FEATURES:append:rk3576 = " bsp/rockchip/remove-non-rockchip-arch-arm64.scc"
UBOOT_MACHINE     ?= "generic-rk3576_defconfig"

UBOOT_SUFFIX ?= "itb"
UBOOT_ENTRYPOINT ?= "0x48000000"

TFA_PLATFORM = "rk3576"
TFA_BUILD_TARGET = "bl31"

ENABLE_STATELESS_VPU_GST ?= "1"
```

## distro/layers/meta-muxnix/conf/machine/luckfox-omni3576.conf
```bitbake
# Copyright (c) 2025, Sebastian Muxel
# Released under the MIT license (see COPYING.MIT for the terms)

#@TYPE: Machine
#@NAME: Luckfox Omni3576
#@DESCRIPTION:

require conf/machine/include/rk3576.inc

# Needed for upstream dtb
PREFERRED_PROVIDER_virtual/kernel = "linux-yocto-dev"

KERNEL_DEVICETREE ?= "rockchip/rk3576-luckfox-omni3576.dtb"
MACHINE_EXTRA_RRECOMMENDS += "kernel-modules"
```
